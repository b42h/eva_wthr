## main/Kconfig.projbuild
```kconfig
menu "Eva Weather"

    config EVA_WIFI_SSID
        string "Wi-Fi SSID"
        default "YOUR_WIFI_SSID"
        help
            Wi-Fi network name used by the ESP32-C6 hosted radio.

    config EVA_WIFI_PASSWORD
        string "Wi-Fi password"
        default "YOUR_WIFI_PASSWORD"
        help
            Wi-Fi password. Change this locally before flashing.

    config EVA_WEATHER_LATITUDE
        string "Weather latitude"
        default "48.915155"
        help
            Latitude for Open-Meteo and Clear Outside requests, decimal
            degrees, north positive. Also drives the solar-elevation model
            that picks the sky palette, so keep it close to where the panel
            actually hangs.

    config EVA_WEATHER_LONGITUDE
        string "Weather longitude"
        default "24.710636"
        help
            Longitude for Open-Meteo and Clear Outside requests, decimal
            degrees, east positive.

endmenu
```
